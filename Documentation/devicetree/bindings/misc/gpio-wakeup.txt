## Documentation/devicetree/bindings/misc/gpio-wakeup.txt
```
GPIO WAKEUP DRIVER BINDINGS

Required:

	compatible:	Must be "gpio-wakeup"
	gpios:		At list of GPIO nodes that are enabled as wakeup
			sources.


Example:

	wake_up {
		compatible = "gpio-wakeup";
		gpios = <&gpio0 19 0>;
	};
```

## Documentation/devicetree/bindings/mmc/ti-omap-hsmmc.txt
```
* TI Highspeed MMC host controller for OMAP

The Highspeed MMC Host Controller on TI OMAP family
provides an interface for MMC, SD, and SDIO types of memory cards.

This file documents differences between the core properties described
by mmc.txt and the properties used by the omap_hsmmc driver.

Required properties:
- compatible:
 Should be "ti,omap2-hsmmc", for OMAP2 controllers
 Should be "ti,omap3-hsmmc", for OMAP3 controllers
 Should be "ti,omap4-hsmmc", for OMAP4 controllers
- ti,hwmods: Must be "mmc<n>", n is controller instance starting 1

Optional properties:
ti,dual-volt: boolean, supports dual voltage cards
<supply-name>-supply: phandle to the regulator device tree node
"supply-name" examples are "vmmc", "vmmc_aux" etc
ti,non-removable: non-removable slot (like eMMC)
ti,needs-special-reset: Requires a special softreset sequence
ti,needs-special-hs-handling: HSMMC IP needs special setting for handling High Speed
dmas: List of DMA specifiers with the controller specific format
as described in the generic DMA client binding. A tx and rx
specifier is required.
dma-names: List of DMA request names. These strings correspond
1:1 with the DMA specifiers listed in dmas. The string naming is
to be "rx" and "tx" for RX and TX DMA requests, respectively.
ti,quirk-swakeup-missing: SOC missing the swakeup line, will not detect
SDIO irq while in suspend. The workaround is to reconfigure the dat1 line as a
GPIO upon suspend. Beyond this option and the GPIO config, you also need to set
named pinctrl states "default", "active" and "idle ", see example below.  The
MMC driver will then then toggle between default and idle during the runtime
Affected chips are am335x,

                            ------
                            | PRCM |
                             ------
                              ^ |
                      swakeup | | fclk
                              | v
      ------                -------               -----
     | card | -- CIRQ -->  | hsmmc | -- IRQ -->  | CPU |
      ------                -------               -----

In suspend the fclk is off and the module is disfunctional. Even
register reads will fail. A small logic in the host will request fclk
restore, when an external event is detected. Once the clock is
restored, the host detects the event normally.

Examples:

[hwmod populated DMA resources]

	mmc1: mmc@0x4809c000 {
		compatible = "ti,omap4-hsmmc";
		reg = <0x4809c000 0x400>;
		ti,hwmods = "mmc1";
		ti,dual-volt;
		bus-width = <4>;
		vmmc-supply = <&vmmc>; /* phandle to regulator node */
		ti,non-removable;
	};

[generic DMA request binding]

	mmc1: mmc@0x4809c000 {
		compatible = "ti,omap4-hsmmc";
		reg = <0x4809c000 0x400>;
		ti,hwmods = "mmc1";
		ti,dual-volt;
		bus-width = <4>;
		vmmc-supply = <&vmmc>; /* phandle to regulator node */
		ti,non-removable;
		dmas = <&edma 24
			&edma 25>;
		dma-names = "tx", "rx";
	};

[am335x with with gpio for sdio irq]

	mmc1_cirq_pin: pinmux_cirq_pin {
		pinctrl-single,pins = <
			0x0f8 0x3f	/* MMC0_DAT1 as GPIO2_28 */
		>;
	};

	mmc1: mmc@48060000 {
		ti,non-removable;
		bus-width = <4>;
		vmmc-supply = <&ldo2_reg>;
		vmmc_aux-supply = <&vmmc>;
	        ti,quirk-swakeup-missing;
		pinctrl-names = "default", "active", "idle";
		pinctrl-0 = <&mmc1_pins>;
		pinctrl-1 = <&mmc1_pins>;
		pinctrl-2 = <&mmc1_cirq_pin>;
		ti,cirq-gpio = <&gpio3 28 0>;
	};
```

## Documentation/devicetree/bindings/mtd/elm.txt
```
Error location module

Required properties:
- compatible: Must be "ti,elm"
- reg: physical base address and size of the registers map.
- interrupts: Interrupt number for the elm.
- interrupt-parent: The parent interrupt controller

Optional properties:
- ti,hwmods: Name of the hwmod associated to the elm

Example:
elm: elm@0 {
	compatible	= "ti,elm";
	reg = <0x48080000 0x2000>;
	interrupt-parent = <&intc>;
	interrupts = <4>;
};
```

## Documentation/devicetree/bindings/mtd/gpmi-nand.txt
```
* Freescale General-Purpose Media Interface (GPMI)

The GPMI nand controller provides an interface to control the
NAND flash chips.

Required properties:
  - compatible : should be "fsl,<chip>-gpmi-nand"
  - reg : should contain registers location and length for gpmi and bch.
  - reg-names: Should contain the reg names "gpmi-nand" and "bch"
  - interrupts : BCH interrupt number.
  - interrupt-names : Should be "bch".
  - dmas: DMA specifier, consisting of a phandle to DMA controller node
    and GPMI DMA channel ID.
    Refer to dma.txt and fsl-mxs-dma.txt for details.
  - dma-names: Must be "rx-tx".

Optional properties:
  - nand-on-flash-bbt: boolean to enable on flash bbt option if not
                       present false
  - fsl,use-minimum-ecc: Protect this NAND flash with the minimum ECC
                       strength required. The required ECC strength is
                       automatically discoverable for some flash
                       (e.g., according to the ONFI standard).
                       However, note that if this strength is not
                       discoverable or this property is not enabled,
                       the software may chooses an implementation-defined
                       ECC scheme.
  - fsl,no-blockmark-swap: Don't swap the bad block marker from the OOB
                       area with the byte in the data area but rely on the
                       flash based BBT for identifying bad blocks.
                       NOTE: this is only valid in conjunction with
                             'nand-on-flash-bbt'.
                       WARNING: on i.MX28 blockmark swapping cannot be
                       disabled for the BootROM in the FCB. Thus,
                       partitions written from Linux with this feature
                       turned on may not be accessible by the BootROM
                       code.
 - fsl,legacy-bch-geometry: Use legacy bch geometry(ECC scheme) that
                       compatible with 3.10 kernel. Without the property,
                       software may use ECC strength according to NAND chip
                       spec, e.g. ONFI standard.

 - timings: node containing the desired timing parameters for the NAND chip,
 	if this node is not present we fall back to the default safe timings.

	NOTE: A zero value in the timing properties indicates that the
	characteristic isn't known.

	Child properties:
	  - data-setup-ns: The data setup time, in nanoseconds. Usually the
	  		maximum of tDS and tWP.
	  - data-hold-ns: The data hold time, in nanoseconds. Usually the
	  		maximum of tDH, tWH and tREH.
	  - address-setup-ns: The address setup time, in nanoseconds. Usually
	  		the maximum of tCLS, tCS and tALS.
	  - sample-delay-ns: A GPMI-specific timing parameter.
	  - trea-ns: tREA, in nanoseconds, from the data sheet.
	  - trloh-ns: tRLOH, in nanoseconds, from the data sheet.
	  - trhoh-ns: tRHOH, in nanoseconds, from the data sheet.

The device tree may optionally contain sub-nodes describing partitions of the
address space. See partition.txt for more detail.

Examples:

gpmi-nand@8000c000 {
	compatible = "fsl,imx28-gpmi-nand";
	#address-cells = <1>;
	#size-cells = <1>;
	reg = <0x8000c000 2000>, <0x8000a000 2000>;
	reg-names = "gpmi-nand", "bch";
	interrupts = <41>;
	interrupt-names = "bch";
	dmas = <&dma_apbh 4>;
	dma-names = "rx-tx";

	timings {
		data-setup-ns = <12>;
		data-hold-ns = <11>;
		address-setup-ns = <20>;
		sample-delay-ns = <0>;
		trea-ns = <5>;
		trloh-ns = <5>;
		trhoh-ns = <25>;
	};

	partition@0 {
	...
	};
};
```

## sound/soc/streamunlimited/Kconfig
```kconfig
config SND_SOC_STREAM
	tristate "Audio support for StreamUnlimited boards designs"
	help
	  Audio support for various reference designs by SUE.

choice

prompt "Selected target"
	default SND_SOC_STREAM_AM33XX
	depends on SND_SOC_STREAM

config SND_SOC_STREAM_AM33XX
	tristate "SUE am33xx support"
	depends on SND_EDMA_SOC
        select SND_DAVINCI_SOC_MCASP
        select SND_SOC_CS4271
        select SND_SOC_AK4104
        select SND_SOC_AK5386
        select SND_SOC_TAS5086
        select SND_SOC_PCM3060
        select SND_SOC_PCMDUMMY
        select SND_SOC_ADAU1701
        select SND_SOC_STA350
        select SND_SOC_SPDI
	help
	  ASoC driver for the Analog Devices AXI-I2S softcore peripheral.

config SND_SOC_STREAM_NXP
	tristate "SUE imx7 support"
	depends on SND_SOC_STREAM
	select SND_SOC_IMX_PCM_DMA
	select SND_SOC_FSL_SAI
	select SND_SOC_FSL_UTILS
	help
	  ASoC driver for the Analog Devices AXI-SPDIF softcore peripheral.

endchoice
```
